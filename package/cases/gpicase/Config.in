## package/cases/gpicase/Config.in
```kconfig
config BR2_PACKAGE_GPICASE
        bool "gpicase"
	depends on BR2_PACKAGE_SYSTEM_TARGET_RPI_ANY
	depends on BR2_LINUX_KERNEL
	select BR2_PACKAGE_XPAD_NOONE

	help

	  https://github.com/RetroFlag/retroflag-picase

comment "gpicase needs a Linux kernel to be built"
	depends on !BR2_LINUX_KERNEL
```

## package/reglinux/utils/hyprland/Config.in
```kconfig
config BR2_PACKAGE_HYPRLAND
	bool "hyprland"
	select BR2_PACKAGE_CAIRO
	select BR2_PACKAGE_CAIRO_PNG
	select BR2_PACKAGE_PANGO

	help
	  Hyprland is a 100% independent, dynamic
	  tiling Wayland compositor that doesn't
	  sacrifice on its looks.

	  https://hyprland.org/
```

## package/reglinux/utils/labwc/Config.in
```kconfig
config BR2_PACKAGE_LABWC
	bool "labwc"
	select BR2_PACKAGE_WLROOTS
	select BR2_PACKAGE_LIBXML2
	select BR2_PACKAGE_LIBPNG
	select BR2_PACKAGE_LIBRSVG
	select BR2_PACKAGE_CAIRO
	select BR2_PACKAGE_PANGO

	help
	  Labwc is a wlroots-based window-stacking
	  compositor for wayland, inspired by openbox.

	  https://labwc.github.io/
```
